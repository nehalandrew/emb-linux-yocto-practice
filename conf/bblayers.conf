## conf/bblayers.conf
```bitbake
# POKY_BBLAYERS_CONF_VERSION is increased each time build/conf/bblayers.conf
# changes incompatibly
POKY_BBLAYERS_CONF_VERSION = "2"

BBPATH = "${TOPDIR}"
BBFILES ?= ""

BBLAYERS ?= " \
  /com.docker.devenvironments.code/sources/poky/meta \
  /com.docker.devenvironments.code/sources/poky/meta-poky \
  /com.docker.devenvironments.code/sources/poky/meta-yocto-bsp \
  /com.docker.devenvironments.code/sources/meta-openembedded/meta-oe \
  /com.docker.devenvironments.code/sources/meta-openembedded/meta-multimedia \
  /com.docker.devenvironments.code/sources/meta-openembedded/meta-networking \
  /com.docker.devenvironments.code/sources/meta-openembedded/meta-python \   
  /com.docker.devenvironments.code/sources/meta-raspberrypi \
  "
```

## yocto/conf/bblayers.conf
```bitbake
# POKY_BBLAYERS_CONF_VERSION is increased each time build/conf/bblayers.conf
# changes incompatibly
POKY_BBLAYERS_CONF_VERSION = "2"

BBPATH = "${TOPDIR}"
BBFILES ?= ""

BBLAYERS ?= " \
  /home/andrew/projects/linux/yocto/poky/meta \
  /home/andrew/projects/linux/yocto/poky/meta-poky \
  /home/andrew/projects/linux/yocto/poky/meta-yocto-bsp \
  /home/andrew/projects/linux/yocto/meta-openembedded/meta-oe \
  /home/andrew/projects/linux/yocto/meta-openembedded/meta-multimedia \
  /home/andrew/projects/linux/yocto/meta-openembedded/meta-networking \
  /home/andrew/projects/linux/yocto/meta-openembedded/meta-python \   
  /home/andrew/projects/linux/yocto/meta-raspberrypi \
  "
```
